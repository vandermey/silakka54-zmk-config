## config/boards/shields/silakka54/Kconfig.defconfig
```kconfig
if SHIELD_SILAKKA54_LEFT

config ZMK_KEYBOARD_NAME
    default "Silakka54"

config ZMK_SPLIT_ROLE_CENTRAL
    default y

endif

if SHIELD_SILAKKA54_LEFT || SHIELD_SILAKKA54_RIGHT

config ZMK_SPLIT
    default y

endif
```

## config/boards/shields/silakka54/Kconfig.shield
```kconfig
config SHIELD_SILAKKA54_LEFT
    def_bool $(shields_list_contains,silakka54_left)

config SHIELD_SILAKKA54_RIGHT
    def_bool $(shields_list_contains,silakka54_right)
```
